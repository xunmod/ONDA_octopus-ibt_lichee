## lichee/linux-3.10/arch/arm/mach-sunxi/Kconfig
```kconfig
if ARCH_SUNXI

choice
	prompt "Select the architecture of SoC"
	default ARCH_SUN8I
	help
	  Select the architecture for SoC
	  sunxi
	  `-- sun8i ----- Cortex-A7 based Family SoCs

config ARCH_SUN8I
	bool "Allwinner A7 smp SoCs"
	select ARM_GIC
	select CPU_V7
	select HAVE_SMP if !ARCH_SUN8IW8
	select SUNXI_TIMER
	select COMMON_CLK
	select CLKDEV_LOOKUP
	select NEED_MACH_IO_H
	select MIGHT_HAVE_CACHE_L2X0
	select PINCTRL
	select PINCTRL_SUNXI
	select ARCH_REQUIRE_GPIOLIB
	select CLKSRC_MMIO
	select CLKSRC_OF
	select GENERIC_CLOCKEVENTS
	select GENERIC_IRQ_CHIP
	select SPARSE_IRQ
	select SUN4I_TIMER
	select HAVE_UNSTABLE_SCHED_CLOCK
	select GENERIC_ALLOCATOR
	help
	  Allwinner A7 smp SoCs(sun8i)

config ARCH_SUN50I
	bool "Allwinner A53 smp SoCs"
	select ARM_GIC
	select CPU_V7
	select HAVE_SMP if !ARCH_SUN8IW8
	select SUNXI_TIMER
	select COMMON_CLK
	select CLKDEV_LOOKUP
	select NEED_MACH_IO_H
	select MIGHT_HAVE_CACHE_L2X0
	select PINCTRL
	select PINCTRL_SUNXI
	select ARCH_REQUIRE_GPIOLIB
	select CLKSRC_MMIO
	select CLKSRC_OF
	select GENERIC_CLOCKEVENTS
	select GENERIC_IRQ_CHIP
	select SPARSE_IRQ
	select SUN4I_TIMER
	select HAVE_UNSTABLE_SCHED_CLOCK
	select GENERIC_ALLOCATOR
	help
	  Allwinner A53 smp SoCs(sun50i)
endchoice

# Select the wafer with sun8i

if ARCH_SUN8I
choice
	prompt "Select the wafer with arch sun8i"
	default ARCH_SUN8IW10
	help
	  Select the wafer with arch sun8i

config ARCH_SUN8IW6
        bool "Allwinner H8 SOCs(sun8iw6)"
        help
          Allwinner sun8iw6 SOCs

config ARCH_SUN8IW5
        bool "Allwinner sun8iw5 SoCs"
        help
          Allwinner sun8iw5 SoCs

config ARCH_SUN8IW10
        bool "Allwinner sun8iw10 SoCs"
        help
          Allwinner sun8iw10 SoCs

config ARCH_SUN8IW11
        bool "Allwinner sun8iw11 SoCs"
        help
          Allwinner sun8iw11 SoCs
endchoice

config SUN8I_CCI
	bool "Cache Coherent Interconnect support"
	depends on ARCH_SUN8IW6
	default n
	help
	  Enable Cache Coherent Interconnect support
endif

# Select the SoC with specific arch and wafer

if ARCH_SUN8IW6
choice
        prompt "Select the chip with wafer sun8iw6"
        default ARCH_SUN8IW6P1
        help
         Select the chip with wafer sun8iw6

config ARCH_SUN8IW6P1
        bool "Allwinner Axx chip(sun8iw6p1)"
        help
          Allwinner sun8iw6p1 SoC
endchoice
endif

if ARCH_SUN8IW5
choice
        prompt "Select the chip with wafer sun8iw5"
        default ARCH_SUN8IW5P1
        help
         Select the chip with wafer sun8iw5

config ARCH_SUN8IW5P1
        bool "Allwinner Axx chip(sun8iw5p1)"
        help
          Allwinner sun8iw5p1 SoC
endchoice
endif

config SUNXI_GIC_ACCESS_SS
    bool "Enable Sunxi GIC Access SS Protect"
    depends on ARCH_SUN8IW6
    default y
    help
        Support for Sunxi GIC Access SS Protect

if ARCH_SUN8IW10
choice
       prompt "Select the SoC with wafer sun8iw10"
       default ARCH_SUN8IW10P1
       help
        Select the SoC with wafer sun8iw10

config ARCH_SUN8IW10P1
       bool "Allwinner sun8iw10p1 SoC"
       help
         Allwinner sun8iw10p1 SoC
endchoice
endif

if ARCH_SUN8IW11
choice
	prompt "Select the SoC with wafer sun8iw11"
	default ARCH_SUN8IW11P1
	help
	 Select the SoC with wafer sun8iw11

config ARCH_SUN8IW11P1
	bool "Allwinner sun8iw11p1 SoC"
	help
	  Allwinner sun8iw11p1 SoC
endchoice
endif

# Select the board between FPGA and EVB

choice
	prompt "Allwinner development Board"
	depends on ARCH_SUNXI
	default FPGA_V4_PLATFORM

config FPGA_V4_PLATFORM
       bool "FPGAv4 board"
       help
         Support for Allwinner's FPGAv4 board

config FPGA_V7_PLATFORM
       bool "FPGAv7 board"
       help
         Support for Allwinner's FPGAv4 board

config EVB_PLATFORM
       bool "EVB board"
       help
         Support for Allwinner's EVB board
endchoice

# Select the wafer with sun50i

if ARCH_SUN50I
choice
	prompt "Select the wafer with arch sun50i"
	default ARCH_SUN50IW1
	help
	  Select the wafer with arch sun50i

config ARCH_SUN50IW1
        bool "Allwinner sun50iw1 SoCs"
        help
          Allwinner sun50iw1 SoCs

config ARCH_SUN50IW2
        bool "Allwinner sun50iw2 SoCs"
        help
          Allwinner sun50iw2 SoCs
endchoice
endif

# Select the SoC with specific arch and wafer

if ARCH_SUN50IW1
choice
       prompt "Select the SoC with wafer sun50iw1"
       default ARCH_SUN50IW1P1
       help
        Select the SoC with wafer sun50iw1

config ARCH_SUN50IW1P1
       bool "Allwinner sun50iw1p1 SoC"
       help
         Allwinner sun50iw1p1 SoC
endchoice
endif

if ARCH_SUN50IW2
choice
	prompt "Select the SoC with wafer sun50iw2"
	default ARCH_SUN50IW2P1
	help
	 Select the SoC with wafer sun50iw2

config ARCH_SUN50IW2P1
	bool "Allwinner sun50iw2p1 SoC"
	help
	  Allwinner sun50iw2p1 SoC
endchoice
endif

config SUNXI_TRUSTZONE
       bool "SUNXI trustzone security"
       default n
    help
        Support for SUNXI trustzone security

config HOMLET_PLATFORM
       bool "Homlet platform Features"
       default n
       help
         Enable special features for box then select Yes,
         For example, fsync & sync immediatetly to nand disk.

config SUNXI_BOOTUP_EXTEND
       bool "Sunxi platform bootup extend"
       default n
       help
         Support sunxi extend bootup.

if SUNXI_BOOTUP_EXTEND
choice
	prompt "Select sunxi bootup extend feature"
	default SUNXI_FAKE_SHUTDOWN
	help

config SUNXI_RTC_REBOOT
       bool "Sunxi rtc reboot Feature"
       help
         Support sunxi rtc reboot, which can save state in rtc reg
         according to the reboot arg.
         This feature need support of reboot program in the userspace,
         such as android reboot. Busybox reboot doesn't support this
         feature.

config SUNXI_FAKE_SHUTDOWN
       bool "Sunxi fake shutdown Feature"
       depends on HOMLET_PLATFORM
       help
         Support system enter fake shutdown(boot standby), which can
         be booted up by IR directly. This featch changes the standard
         reboot route. It also ignores the reboot arg.
         TODO: This feature should be realized through reboot arg
         from the userspace
         Say N if you are unsure.
endchoice
endif

config SUNXI_SOC_NAME
	string "The name of SUNXI SoC"
	default ""
	help
	  Used for /proc/cpuinfo and /sysfs/.../sysinfo.

endif
```

## u-boot/configs/onda_v975s_core8_defconfig
```kconfig
CONFIG_ARM=y
CONFIG_ARCH_SUNXI=y
CONFIG_DEFAULT_DEVICE_TREE="sun8i-a83t-onda-v975s"
CONFIG_SPL=y
CONFIG_MACH_SUN8I_A83T=y
CONFIG_DRAM_CLK=672
CONFIG_DRAM_ZQ=15291
CONFIG_DRAM_ODT_EN=y
CONFIG_MMC_SUNXI_SLOT_EXTRA=1
CONFIG_USB0_VBUS_PIN="AXP0-VBUS-ENABLE"
CONFIG_USB0_ID_DET="PH11"
CONFIG_AXP_GPIO=y
# CONFIG_SYS_MALLOC_CLEAR_ON_INIT is not set
CONFIG_SD_BOOT=y
CONFIG_LOG=y
# CONFIG_CMD_CLS is not set
CONFIG_ENV_IS_IN_MMC=y
CONFIG_BUTTON=y
CONFIG_BUTTON_GPIO=y
CONFIG_FASTBOOT_CMD_OEM_FORMAT=y
CONFIG_REGULATOR_AXP_USB_POWER=y
CONFIG_AXP_DCDC5_VOLT=1200
CONFIG_USB_EHCI_HCD=y
CONFIG_USB_OHCI_HCD=y
CONFIG_USB_MUSB_GADGET=y
CONFIG_USB_FUNCTION_MASS_STORAGE=y
CONFIG_VIDEO=y
CONFIG_BACKLIGHT_GPIO=y
CONFIG_VIDEO_VESA=y
CONFIG_FRAMEBUFFER_SET_VESA_MODE=y
CONFIG_VIDEO_DT_SIMPLEFB=y
```
